## Config.in
```kconfig
mainmenu "Package $(VERSION) Configuration"

comment "package build system"

config HAVE_DOT_CONFIG
	bool
	default y

config OPTIMIZE_LEVEL3
	bool "optimize level 3 (-O3)"
	default n

config DEBUG
	bool "Debug mode"
	default n

config USE_CXX11_ABI
	bool "use cxx11 abi"
	default y

config TRACE
	bool "trace function"
	default y

source "package/Config.in"
```

## package/example-lib/Config.in
```kconfig
config LIB_EXAMPLE
	bool "Hello example library"
	help
		This is a test example library.
```

## package/example/Config.in
```kconfig
config HELLO_EXAMPLE
	bool "Hello Example function"
	depends on LIB_EXAMPLE
	help
		This is a test example.
```
